// oled.cpp -- minimal SSD1306 72x40 driver (ESP-IDF new i2c_master API).
//
// The 0.42" 72x40 panel maps its visible area to GDDRAM columns 28..99 and
// pages 0..4, so every flush programs that window explicitly.

#include "oled.h"

#include <cstring>
#include "driver/i2c_master.h"
#include "esp_log.h"

static const char* TAG = "oled";

#define SSD1306_ADDR   0x3C
#define COL_OFFSET     28
#define PAGES          (OLED_H / 8)      // 5

static i2c_master_dev_handle_t s_dev = nullptr;
static uint8_t s_fb[OLED_W * PAGES];     // 72 * 5 = 360 bytes

// 5x7 font, ASCII 0x20..0x7A. Each glyph = 5 column bytes, bit0 = top row.
static const uint8_t FONT[][5] = {
  {0x00,0x00,0x00,0x00,0x00}, // ' '
  {0x00,0x00,0x5F,0x00,0x00}, // !
  {0x00,0x07,0x00,0x07,0x00}, // "
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  {0x44,0x64,0x54,0x4C,0x44}, // z
};

static void cmd(uint8_t c) {
  uint8_t buf[2] = {0x00, c};
  i2c_master_transmit(s_dev, buf, sizeof(buf), 100);
}

bool oled_init(gpio_num_t sda, gpio_num_t scl) {
  i2c_master_bus_config_t bus = {};
  bus.i2c_port = -1;  // auto-select
  bus.sda_io_num = sda;
  bus.scl_io_num = scl;
  bus.clk_source = I2C_CLK_SRC_DEFAULT;
  bus.glitch_ignore_cnt = 7;
  bus.flags.enable_internal_pullup = true;

  i2c_master_bus_handle_t bh = nullptr;
  if (i2c_new_master_bus(&bus, &bh) != ESP_OK) {
    ESP_LOGE(TAG, "i2c bus init failed");
    return false;
  }

  i2c_device_config_t dev = {};
  dev.dev_addr_length = I2C_ADDR_BIT_LEN_7;
  dev.device_address = SSD1306_ADDR;
  dev.scl_speed_hz = 400000;
  if (i2c_master_bus_add_device(bh, &dev, &s_dev) != ESP_OK) {
    ESP_LOGE(TAG, "i2c add device failed");
    return false;
  }

  static const uint8_t init_seq[] = {
    0xAE,              // display off
    0xD5, 0x80,        // clock
    0xA8, 0x27,        // multiplex = 40
    0xD3, 0x00,        // display offset
    0x40,              // start line 0
    0x8D, 0x14,        // charge pump on
    0x20, 0x00,        // horizontal addressing mode
    0xA1,              // segment remap
    0xC8,              // COM scan dec
    0xDA, 0x12,        // COM pins
    0x81, 0xCF,        // contrast
    0xD9, 0xF1,        // pre-charge
    0xDB, 0x40,        // VCOMH
    0xA4,              // resume from RAM
    0xA6,              // normal (not inverted)
    0xAF,              // display on
  };
  for (uint8_t c : init_seq) cmd(c);

  oled_clear();
  oled_flush();
  ESP_LOGI(TAG, "SSD1306 72x40 ready");
  return true;
}

void oled_clear() { std::memset(s_fb, 0, sizeof(s_fb)); }

void oled_flush() {
  if (!s_dev) return;
  cmd(0x21); cmd(COL_OFFSET); cmd(COL_OFFSET + OLED_W - 1);  // column window
  cmd(0x22); cmd(0x00); cmd(PAGES - 1);                      // page window

  uint8_t out[1 + sizeof(s_fb)];
  out[0] = 0x40;  // data control byte
  std::memcpy(out + 1, s_fb, sizeof(s_fb));
  i2c_master_transmit(s_dev, out, sizeof(out), 100);
}

static void set_pixel(int x, int y) {
  if (x < 0 || x >= OLED_W || y < 0 || y >= OLED_H) return;
  s_fb[x + (y / 8) * OLED_W] |= (1 << (y % 8));
}

static int char_width(int scale) { return 6 * scale; }  // 5 px glyph + 1 gap

void oled_text(int x, int y, const char* s, int scale) {
  for (; *s; ++s) {
    unsigned char ch = static_cast<unsigned char>(*s);
    if (ch < 0x20 || ch > 0x7A) ch = 0x20;
    const uint8_t* g = FONT[ch - 0x20];
    for (int col = 0; col < 5; ++col) {
      uint8_t bits = g[col];
      for (int row = 0; row < 7; ++row) {
        if (bits & (1 << row)) {
          for (int dx = 0; dx < scale; ++dx)
            for (int dy = 0; dy < scale; ++dy)
              set_pixel(x + col * scale + dx, y + row * scale + dy);
        }
      }
    }
    x += char_width(scale);
  }
}

void oled_text_centered(int y, const char* s, int scale) {
  int w = static_cast<int>(std::strlen(s)) * char_width(scale) - scale;  // trim last gap
  int x = (OLED_W - w) / 2;
  if (x < 0) x = 0;
  oled_text(x, y, s, scale);
}

void oled_show_lines(const char* l1, const char* l2, const char* l3, const char* l4) {
  const char* lines[4] = {l1, l2, l3, l4};
  int n = 0;
  for (int i = 0; i < 4; ++i) if (lines[i] && lines[i][0]) n = i + 1;
  oled_clear();
  const int lineH = 9;                 // 7px glyph + 2px gap
  int total = n * lineH;
  int y = (OLED_H - total) / 2;
  if (y < 0) y = 0;
  for (int i = 0; i < n; ++i) {
    if (lines[i] && lines[i][0]) oled_text_centered(y, lines[i], 1);
    y += lineH;
  }
  oled_flush();
}

void oled_show_big(const char* word) {
  oled_clear();
  int scale = 3;
  int h = 7 * scale;
  int y = (OLED_H - h) / 2;
  oled_text_centered(y, word, scale);
  oled_flush();
}
