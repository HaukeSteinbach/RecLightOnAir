## OnAirLinkFirmware/sdkconfig.defaults
```kconfig
# Defaults applied on a fresh build (sdkconfig itself is git-ignored).

# Ableton Link requires C++ exceptions.
CONFIG_COMPILER_CXX_EXCEPTIONS=y

# Link + asio + WiFi need a large app partition (no OTA).
CONFIG_PARTITION_TABLE_SINGLE_APP_LARGE=y

# 1 kHz FreeRTOS tick.
CONFIG_FREERTOS_HZ=1000

# app_main runs the Link object + poll loop; give it headroom.
CONFIG_ESP_MAIN_TASK_STACK_SIZE=8192

# The ESP32-C3's only USB is the USB-Serial/JTAG peripheral; route the console
# there so logs appear over /dev/cu.usbmodem* (default is UART0).
CONFIG_ESP_CONSOLE_USB_SERIAL_JTAG=y

# BLE (NimBLE) peripheral for "Plugin via Bluetooth" studio mode. Only
# initialised at runtime when that mode is selected (see ble_server.*); the
# controller/host stack itself still needs to be compiled in.
CONFIG_BT_ENABLED=y
CONFIG_BT_NIMBLE_ENABLED=y
CONFIG_BT_BLUEDROID_ENABLED=n
# We are a GATT peripheral only -- disable the central/observer roles to save
# flash and RAM.
CONFIG_BT_NIMBLE_ROLE_CENTRAL_DISABLED=y
CONFIG_BT_NIMBLE_ROLE_OBSERVER_DISABLED=y
CONFIG_BT_NIMBLE_MAX_CONNECTIONS=1

# Default LWIP_MAX_SOCKETS=10 is too low: the HTTP captive portal alone
# reserves 7 (HTTPD_DEFAULT_CONFIG max_open_sockets), leaving only 3 for our
# own UDP tasks (provisioning/control/announce/DNS) plus Ableton Link's
# per-interface multicast/unicast sockets (AP+STA = up to ~4 more). This was
# the actual root cause of persistent "peers=0": Link's gateway init was
# silently failing with ENFILE ("Too many open files in system") on every
# interface, every scan cycle. Bump the pool well above what we need.
CONFIG_LWIP_MAX_SOCKETS=16
```
